/*
 * Copyright (c) 2020 Pete Johanson
 *
 * SPDX-License-Identifier: MIT
 */

#include "am_hatsu.dtsi"

&kscan0 {
	// col-gpios
	// 	= <&gpio0 10 (GPIO_ACTIVE_HIGH | GPIO_PULL_DOWN)>  // B4
	// 	, <&gpio0 9  (GPIO_ACTIVE_HIGH | GPIO_PULL_DOWN)>  // E6
	// 	, <&gpio0 13 (GPIO_ACTIVE_HIGH | GPIO_PULL_DOWN)>  // C6
	// 	, <&gpio1 13 (GPIO_ACTIVE_HIGH | GPIO_PULL_DOWN)>  // B1
	// 	, <&gpio0 3  (GPIO_ACTIVE_HIGH | GPIO_PULL_DOWN)>  // B3
	// 	, <&gpio0 28 (GPIO_ACTIVE_HIGH | GPIO_PULL_DOWN)>  // B2
	// 	;
	col-gpios
	= <&pro_micro 19 GPIO_ACTIVE_HIGH> // col1 in the schematic
	, <&pro_micro 18 GPIO_ACTIVE_HIGH> // col2 in the schematic
	, <&pro_micro 15 GPIO_ACTIVE_HIGH> // col3 in the schematic
	, <&pro_micro 14 GPIO_ACTIVE_HIGH> // col4 in the schematic
	, <&pro_micro 16 GPIO_ACTIVE_HIGH> // col5 in the schematic
	, <&pro_micro 10 GPIO_ACTIVE_HIGH> // col6 in the schematic
	;
};
